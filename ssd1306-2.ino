/* oled-text.ino - drive the SSD1306 from the little C906 core with no OS,
 * no Wire library, and no DesignWare controller: bit-bang I2C on the header
 * pads and reuse the same transport-agnostic ssd1306.h as the Linux examples.
 *
 * VERIFIED on the Milk-V Duo S via remoteproc. Header pin 11 = XGPIOB[11] =
 * IIC1_SDA, pin 13 = XGPIOB[12] = IIC1_SCL. The little core runs in M-mode,
 * so the register addresses below are physical: no /dev/mem, no mmap.
 *
 * NOTE: this bit-bang path does NOT use the kernel I2C controller; it
 * reprograms the B11/B12 pad-mux registers as plain GPIO itself.
 *
 * Build: arduino-cli compile --fqbn sophgo:SG200X:duos --build-path build
 * oled-text
 */
#include <string.h>

#include "ssd1306.h"

const unsigned char aaaa[] PROGMEM = {
    0x00, 0x00, 0x00, 0x00, 0x00, 0x00, 0x00, 0x00, 0x00, 0x00, 0x00, 0x00,
    0x00, 0x00, 0x00, 0x00, 0x00, 0x00, 0x00, 0x00, 0x00, 0x00, 0x00, 0x00,
    0x00, 0x00, 0x00, 0x00, 0x00, 0x00, 0x00, 0x00, 0x00, 0x00, 0x00, 0x00,
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    0x00, 0x00, 0x00, 0x00};

#define MESSAGE "Hello from C906"

#define MUX_B11                                                                \
  0x03001134UL /* XGPIOB[11] pad function (header pin 11, SDA)                 \
                */
#define MUX_B12                                                                \
  0x03001138UL /* XGPIOB[12] pad function (header pin 13, SCL)                 \
                */
#define GPIOB_BASE 0x03021000UL
#define SDA 11
#define SCL 12
#define FUNC_GPIO 3u

#define DR (GPIOB_BASE + 0x00)
#define DDR (GPIOB_BASE + 0x04)
#define EXT (GPIOB_BASE + 0x50)

static inline uint32_t r32(uint32_t a) { return *(volatile uint32_t *)a; }
static inline void w32(uint32_t a, uint32_t v) { *(volatile uint32_t *)a = v; }

/* open-drain emulation: drive low as output, release (high-Z) for high */
static void pad_out(int bit, int high) {
  uint32_t d = r32(DR);
  if (high)
    d |= (1u << bit);
  else
    d &= ~(1u << bit);
  w32(DR, d);
  w32(DDR, r32(DDR) | (1u << bit));
}
static void pad_rel(int bit) { w32(DDR, r32(DDR) & ~(1u << bit)); }
static void sda_low(void) { pad_out(SDA, 0); }
static void sda_rel(void) { pad_rel(SDA); }
static void scl_low(void) { pad_out(SCL, 0); }
static void scl_rel(void) { pad_rel(SCL); }
static int sda_val(void) {
  pad_rel(SDA);
  return (int)((r32(EXT) >> SDA) & 1u);
}

static void half(void) { delayMicroseconds(5); } /* ~70 kHz */

static void i2c_start(void) {
  sda_rel();
  scl_rel();
  half();
  sda_low();
  half();
  scl_low();
  half();
}
static void i2c_stop(void) {
  sda_low();
  half();
  scl_rel();
  half();
  sda_rel();
  half();
}
static void wbit(int b) {
  if (b)
    sda_rel();
  else
    sda_low();
  half();
  scl_rel();
  half();
  scl_low();
  half();
}
static int rbit(void) {
  sda_rel();
  half();
  scl_rel();
  half();
  int v = sda_val();
  scl_low();
  half();
  return v;
}
static int wbyte(uint8_t v) {
  for (int i = 7; i >= 0; i--)
    wbit((v >> i) & 1);
  return rbit(); /* 0 = ACK */
}

static int wbuf(const uint8_t *b, size_t n) {
  i2c_start();
  if (wbyte((uint8_t)(OLED_ADDR << 1)) != 0) {
    i2c_stop();
    return -1;
  }
  for (size_t i = 0; i < n; i++)
    (void)wbyte(b[i]);
  i2c_stop();
  return 0;
}

/* transport callback expected by ssd1306.h */
static void oled_cb(void *ctx, const uint8_t *buf, size_t len, int is_data) {
  (void)ctx;
  uint8_t tmp[1 + 64];
  for (size_t off = 0; off < len; off += 64) {
    size_t n = len - off;
    if (n > 64)
      n = 64;
    tmp[0] = is_data ? 0x40 : 0x00;
    memcpy(tmp + 1, buf + off, n);
    (void)wbuf(tmp, n + 1);
  }
}

static oled_t o;

void setup() {
  w32(MUX_B11, (r32(MUX_B11) & ~0x7u) | FUNC_GPIO);
  w32(MUX_B12, (r32(MUX_B12) & ~0x7u) | FUNC_GPIO);
  sda_rel();
  scl_rel();

  oled_init(&o, oled_cb, NULL);
  // oled_text(&o, 0, 0, MESSAGE);
  // oled_text(&o, 0, 12, "SSD1306 I2C");

  for (int y = 0; y < OLED_H; y++) {
    for (int x = 0; x < OLED_W; x++) {
      int row = y * 16; // every row contains 16 bytes
      int col = x / 8;  // every column contains 8 bytes
      // int bit = aaaa[row + col] >> colBit;
      int bit = aaaa[row + col] & (0b10000000 >> (x % 8));
      if (bit != 0)
        oled_pixel(&o, x, y);
    }
  }

  oled_flush(&o);
}

void loop() { delay(1000); }
